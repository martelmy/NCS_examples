## Kconfig
```
#
# Copyright (c) 2022 Nordic Semiconductor ASA
#
# SPDX-License-Identifier: LicenseRef-Nordic-5-Clause
#
menu "Wi-Fi Provisioning"

module = WIFI_PROVISIONING
module-str = wifi provisioning service
source "${ZEPHYR_BASE}/subsys/logging/Kconfig.template.log_config"

config WIFI_TWT_ENABLED
    bool "Enable support for TWT (Target Wake Time)"
    default n

endmenu

source "Kconfig.zephyr"
```

## prj.conf
```kconfig
#
# Copyright (c) 2022 Nordic Semiconductor ASA
#
# SPDX-License-Identifier: LicenseRef-Nordic-5-Clause
#
CONFIG_WIFI=y
CONFIG_WIFI_NRF700X=y
CONFIG_NET_SHELL=y
CONFIG_DK_LIBRARY=y
CONFIG_NRF_WIFI_LOW_POWER=y
# WPA supplicant
CONFIG_WPA_SUPP=y

# System settings
CONFIG_NEWLIB_LIBC=y
CONFIG_NEWLIB_LIBC_NANO=n

# Networking
CONFIG_NETWORKING=y
CONFIG_NET_SOCKETS=y
CONFIG_POSIX_API=y
CONFIG_NET_LOG=y
CONFIG_NET_IPV6=n
CONFIG_NET_IPV4=y
CONFIG_NET_UDP=y
CONFIG_NET_TCP=y
CONFIG_NET_DHCPV4=y
CONFIG_DNS_RESOLVER=y

CONFIG_NET_STATISTICS=y

CONFIG_NET_PKT_RX_COUNT=8
CONFIG_NET_PKT_TX_COUNT=8

# Below section is the primary contributor to SRAM and is currently
# tuned for performance, but this will be revisited in the future.
CONFIG_NET_BUF_RX_COUNT=16
CONFIG_NET_BUF_TX_COUNT=16
CONFIG_NET_BUF_DATA_SIZE=128
CONFIG_HEAP_MEM_POOL_SIZE=153600
CONFIG_NET_TC_TX_COUNT=0

CONFIG_NET_IF_UNICAST_IPV4_ADDR_COUNT=1
CONFIG_NET_MAX_CONTEXTS=5
CONFIG_NET_CONTEXT_SYNC_RECV=y

CONFIG_INIT_STACKS=y

CONFIG_NET_L2_ETHERNET=y

CONFIG_NET_CONFIG_SETTINGS=y

CONFIG_NET_CONFIG_MY_IPV4_ADDR="192.165.100.150"
CONFIG_NET_CONFIG_PEER_IPV4_ADDR="192.165.100.1"

CONFIG_NET_SOCKETS_POLL_MAX=4

# Memories
CONFIG_MAIN_STACK_SIZE=4096
CONFIG_SYSTEM_WORKQUEUE_STACK_SIZE=2048
CONFIG_NET_TX_STACK_SIZE=4096
CONFIG_NET_RX_STACK_SIZE=4096

# Debugging
CONFIG_STACK_SENTINEL=y
CONFIG_DEBUG_COREDUMP=y
CONFIG_DEBUG_COREDUMP_BACKEND_LOGGING=y
CONFIG_DEBUG_COREDUMP_MEMORY_DUMP_MIN=y

# Kernel options
CONFIG_ENTROPY_GENERATOR=y

# Logging
CONFIG_LOG=y

CONFIG_NET_L2_WIFI_MGMT=y

CONFIG_NET_MGMT_EVENT_STACK_SIZE=2048

CONFIG_BT=y
CONFIG_BT_DEBUG_LOG=y
CONFIG_BT_SMP=y
CONFIG_BT_PERIPHERAL=y

CONFIG_BT_BUF_ACL_RX_SIZE=151
CONFIG_BT_L2CAP_TX_MTU=147
CONFIG_BT_BUF_ACL_TX_SIZE=151

CONFIG_BT_RX_STACK_SIZE=4096
CONFIG_BT_BONDABLE=n
CONFIG_BT_DEVICE_NAME_DYNAMIC=y

CONFIG_FLASH=y
CONFIG_FLASH_PAGE_LAYOUT=y
CONFIG_FLASH_MAP=y

CONFIG_NVS=y

CONFIG_SETTINGS=y
CONFIG_SETTINGS_NVS=y

CONFIG_NANOPB=y

CONFIG_WIFI_PROVISIONING_LOG_LEVEL_DBG=y

# Optimized networking settings for performance
CONFIG_NET_PKT_RX_COUNT=32
CONFIG_NET_PKT_TX_COUNT=48
CONFIG_NET_BUF_RX_COUNT=32
CONFIG_NET_BUF_TX_COUNT=96
CONFIG_HEAP_MEM_POOL_SIZE=200000
CONFIG_NET_BUF_DATA_SIZE=1100

CONFIG_WIFI_TWT_ENABLED=y
```

## src/main.c
```c
/*
 * Copyright (c) 2022 Nordic Semiconductor ASA
 *
 * SPDX-License-Identifier: LicenseRef-Nordic-5-Clause
 */
#include <zephyr/types.h>
#include <stddef.h>
#include <string.h>
#include <errno.h>
#include <zephyr/sys/printk.h>
#include <zephyr/kernel.h>
#include <dk_buttons_and_leds.h>
#include "wifi_provisioning.h"
#ifdef CONFIG_NET_SHELL
#include <zephyr/shell/shell.h>
#include <zephyr/shell/shell_uart.h>

const struct shell *shell_backend;
static bool ping_cmd_recv;
#endif

static void button_handler(uint32_t button_state, uint32_t has_changed)
{
	uint32_t button = button_state & has_changed;
	if (button & DK_BTN1_MSK)
	{
#ifdef CONFIG_NRF_WIFI_LOW_POWER
#ifdef CONFIG_WIFI_TWT_ENABLED
		wifi_set_twt();
#else
		wifi_set_power_state();
#endif /* CONFIG_WIFI_TWT_ENABLED */
#endif /* CONFIG_NRF_WIFI_LOW_POWER */
	}
	if (button & DK_BTN2_MSK)
	{
		/* Cannot call it directly from dk-buttons-and-leds
		 *  workq item, looks like priority is equal to shell subsys
		 */
		dk_set_led(DK_LED2, 1);
		ping_cmd_recv = true;
	}
}

void main(void)
{
	int rc;
	struct wifi_config config;
	struct net_if *iface = net_if_get_default();
	struct wifi_connect_req_params cnx_params = {0};

	int err;
#ifdef CONFIG_NET_SHELL
	shell_backend = shell_backend_uart_get_ptr();
#endif
	err = dk_buttons_init(button_handler);
	if (err)
	{
		printk("Cannot init buttons (err: %d)", err);
	}

	err = dk_leds_init();
	if (err)
	{
		printk("Cannot init LEDs (err: %d)", err);
	}

	/* Sleep 1 seconds to allow initialization of wifi driver. */
	k_sleep(K_SECONDS(1));

	rc = wifi_config_init();
	if (rc != 0)
	{
		printk("Initializing config module failed, err = %d.\n", rc);
		return;
	}

	rc = wifi_prov_init();
	if (rc == 0)
	{
		printk("Wi-Fi provisioning service starts successfully.\n");
	}
	else
	{
		printk("Error occurs when initializing Wi-Fi provisioning service.\n");
		return;
	}

	if (wifi_has_config())
	{
		rc = wifi_get_config(&config);
		if (rc == 0)
		{
			printk("Configuration found. Try to apply.\n");

			cnx_params.ssid = config.ssid;
			cnx_params.ssid_length = config.ssid_len;
			cnx_params.security = config.auth_type;

			cnx_params.psk = NULL;
			cnx_params.psk_length = 0;
			cnx_params.sae_password = NULL;
			cnx_params.sae_password_length = 0;

			if (config.auth_type != WIFI_SECURITY_TYPE_NONE)
			{
				cnx_params.psk = config.password;
				cnx_params.psk_length = config.password_len;
			}

			cnx_params.channel = config.channel;
			cnx_params.band = config.band;
			cnx_params.mfp = WIFI_MFP_OPTIONAL;
			rc = net_mgmt(NET_REQUEST_WIFI_CONNECT, iface,
						  &cnx_params, sizeof(struct wifi_connect_req_params));
			if (rc < 0)
			{
				printk("Cannot apply saved Wi-Fi configuration, err = %d.\n", rc);
			}
			else
			{
				printk("Configuration applied.\n");
			}
		}
	}
	while (1)
	{
		k_sleep(K_MSEC(1000));
		/* Scheduling the shell ping to main thread
		 * ie, a lower prio than workq
		 */
		if (ping_cmd_recv)
		{
#ifdef CONFIG_NET_SHELL
			char ping_cmd[64] = "net ping 8.8.8.8";
			int ret = shell_execute_cmd(shell_backend, ping_cmd);
			if (ret)
			{
				printk("shell error: %d\n", ret);
			}
			ping_cmd_recv = false;
			dk_set_led(DK_LED2, 0);
#endif
		}
	}
}
```

## inc/wifi_provisioning.h
```c
/*
 * Copyright (c) 2022 Nordic Semiconductor ASA
 *
 * SPDX-License-Identifier: LicenseRef-Nordic-5-Clause
 */
/**
 * @file wifi_provisioning.h
 *
 * @brief WiFi Provisioning Service
 */
#ifndef WIFI_PROVISIONING_H_
#define WIFI_PROVISIONING_H_

#include <zephyr/bluetooth/uuid.h>
#include <zephyr/net/wifi.h>
#include <zephyr/net/wifi_mgmt.h>

#ifdef __cplusplus
extern "C" {
#endif

/**
 * @def PROV_SVC_VER
 *
 * Firmware version.
 */
#define PROV_SVC_VER	0x01

/** Data structure to hold Wi-Fi credential */
struct wifi_config {
	/** String of SSID. */
	uint8_t                  ssid[WIFI_SSID_MAX_LEN];
	/** Length of SSID. */
	uint16_t                 ssid_len;
	/** Bytes of BSSID. */
	uint8_t                  bssid[WIFI_MAC_ADDR_LEN];
	/** String of password. */
	uint8_t                  password[WIFI_PSK_MAX_LEN];
	/** Length of password. */
	uint16_t                 password_len;
	/** Authendication method. */
	enum wifi_security_type  auth_type;
	/** Band of access point. */
	uint8_t                  band;
	/** Channel of access point. */
	uint8_t                  channel;
};

/**
 * @brief Check if there exists valid configuration (i.e., the device is provisioned).
 *
 * @return true if valid configuration found, false otherwise.
 */
bool wifi_has_config(void);

/**
 * @brief Get saved configuration.
 *
 * The value is copied to the pointer.
 * User must call wifi_has_config() first to test if a valid configuration exists.
 * The config must not be used if wifi_has_config() returns false.
 *
 * @return 0 if configuration retrieved successfully, negative error code otherwise.
 */
int wifi_get_config(struct wifi_config *config);

/**
 * @brief Save the configuration.
 *
 * If ram_only is set, the configuration will be saved in RAM only.
 * Otherwise, it will be saved in both RAM and Flash.
 *
 * @return 0 if configuration saved successfully, negative error code otherwise.
 */
int wifi_set_config(struct wifi_config *config, bool ram_only);

/**
 * @brief Mark the configuration as valid.
 *
 * Only valid configuration will lead to device state of "provisioned".
 *
 * @return 0 if configuration marked successfully, negative error code otherwise.
 */
int wifi_commit_config(void);

/**
 * @brief Remove the configuration.
 *
 * @return 0 if configuration removed successfully, negative error code otherwise.
 */
int wifi_remove_config(void);

/**
 * @brief Initialize the configuration module.
 *
 * @return 0 if module initialized successfully, negative error code otherwise.
 */
int wifi_config_init(void);

/**
 * @brief Initialize the provisioning module.
 *
 * @return 0 if module initialized successfully, negative error code otherwise.
 */
int wifi_prov_init(void);

/**
 * @brief Set power save mode
 * 
 * @return 0 if successful
*/
int wifi_set_power_state();

int wifi_set_twt();

#ifdef __cplusplus
}
#endif

#endif /* WIFI_PROVISIONING_H_ */
```
