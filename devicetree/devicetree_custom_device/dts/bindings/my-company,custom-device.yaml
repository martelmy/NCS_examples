## devicetree/devicetree_custom_device/dts/bindings/my-company,custom-device.yaml
```yaml
include: base.yaml

compatible: "my-company,custom-device"
description: Custom devicetree device
properties:
  in-gpios:
    type: phandle-array
    description: input gpio pins
    required: true
  out-gpios:
    type: phandle-array
    description: output gpio pins
    required: true
```

## zigbee/light_bulb_dongle/boards/nrf52840dongle_nrf52840.conf
```kconfig
# driver/subsys. Use the deferred mode instead.
CONFIG_LOG_MODE_DEFERRED=y

#USB device
CONFIG_USB_DEVICE_STACK=y
CONFIG_USB_DEVICE_PRODUCT="Zephyr USB console sample"
CONFIG_USB_DEVICE_MANUFACTURER="Nordic Semiconductor ASA"
CONFIG_USB_DEVICE_VID=0x1915
CONFIG_USB_DEVICE_PID=0x0100

CONFIG_UART_LINE_CTRL=y

CONFIG_USB_CDC_ACM_LOG_LEVEL_OFF=y
```
